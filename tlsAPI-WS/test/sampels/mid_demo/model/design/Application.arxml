AUTOSAR XML (schema 00049)
package /vwg/applications/@EXECUTABLE_NAME@/design
  adaptive application sw component type RootSWC
  executable @EXECUTABLE_NAME@: category=APPLICATION_LEVEL, version=1.0.0
    root sw component prototype @EXECUTABLE_NAME@RootSWC: application-type=RootSWC
  process design @EXECUTABLE_NAME@ProcessDesign: executable=@EXECUTABLE_NAME@
